## Documentation/devicetree/bindings/arm/firmware/optee,optee-tz.txt
```
OP-TEE Device Tree Bindings

OP-TEE is a piece of software using hardware features to provide a Trusted
Execution Environment. The security can be provided with ARM TrustZone, but
also by virtualization or a separate chip. As there's no single OP-TEE
vendor we're using "optee" as the first part of compatible property,
indicating the OP-TEE protocol is used when communicating with the secure
world.

* OP-TEE based on ARM TrustZone required properties:

- compatible     : should contain "optee,optee-tz"

- method         : The method of calling the OP-TEE Trusted OS. Permitted
                   values are:

                   "smc" : SMC #0, with the register assignments specified
		           in drivers/tee/optee/optee_smc.h

                   "hvc" : HVC #0, with the register assignments specified
		           in drivers/tee/optee/optee_smc.h



Example:
	optee {
		compatible = "optee,optee-tz";
		method = "smc";
	};
```

## Documentation/devicetree/bindings/optee/optee.txt
```
OP-TEE Device Tree Bindings

OP-TEE is a piece of software using hardware features to provide a Trusted
Execution Environment. The security can be provided with ARM TrustZone, but
also by virtualization or a separate chip. As there's no single OP-TEE
vendor we're using "optee" as the first part of compatible property,
indicating the OP-TEE protocol is used when communicating with the secure
world.

* OP-TEE based on ARM TrustZone required properties:

- compatible="optee,optee-tz"

Example:
	optee {
		compatible="optee,optee-tz";
	};
```

## drivers/tee/Kconfig
```kconfig
# Generic Trusted Execution Environment Configuration
config TEE
	bool "Trusted Execution Environment support"
	default n
	select DMA_SHARED_BUFFER
	help
	  This implements a generic interface towards a Trusted Execution
	  Environment (TEE).

if TEE

menu "TEE drivers"

source "drivers/tee/optee/Kconfig"

endmenu

endif
```

## drivers/tee/optee/Kconfig
```kconfig
# OP-TEE Trusted Execution Environment Configuration
config OPTEE
	tristate "OP-TEE"
	default n
	depends on ARM || ARM64
	help
	  This implements the OP-TEE Trusted Execution Environment (TEE)
	  driver.

if OPTEE
menu "OP-TEE options"
config OPTEE_USE_CMA
	bool "Use CMA"
	default n
	select DMA_CMA
	help
	  Configures OP-TEE driver to use CMA for shared memory allocations.
endmenu
endif
```
